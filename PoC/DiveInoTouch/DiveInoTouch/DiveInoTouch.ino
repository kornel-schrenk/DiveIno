#include <Adafruit_GFX.h>     // Core graphics library
#include <Adafruit_ILI9341.h> // Hardware-specific library
#include <Adafruit_FT6206.h>  // Touch screen support
#include <RTClib.h>
#include <SPI.h>
#include <SdFat.h>
#include <Wire.h>
#include <MS5803_14.h>

#include "Screens\CalendarScreen.h"
#include "Screens\SettingsScreen.h"
#include "Screens\AboutScreen.h"
#include "Screens\HomeScreen.h"
#include "Screens\GaugeScreen.h"
#include "Screens\DiveScreen.h"

#include "Utils\ScreenUtils.h"
#include "Utils\TimeUtils.h"
#include "Utils\DiveUtils.h"

const String VERSION_NUMBER = "0.2.3";

// TFT display and SD card will share the hardware SPI interface.
// Hardware SPI pins are specific to the Arduino board type and
// cannot be remapped to alternate pins.  For Arduino Uno,
// Duemilanove, etc., pin 11 = MOSI, pin 12 = MISO, pin 13 = SCK.
#define TFT_DC_PIN 9
#define TFT_CS_PIN 10
Adafruit_ILI9341 tft = Adafruit_ILI9341(TFT_CS_PIN, TFT_DC_PIN);
Adafruit_FT6206 touchScreen = Adafruit_FT6206();

// SD card initialization
#define SD_CS_PIN 4
SdFat SD;

// RTC initialization
RTC_DS1307 rtc;
unsigned long timerTimestamp;

// Pressure Sensor initialization
MS_5803 pressureSensor = MS_5803(512);

ScreenUtils screenUtils = ScreenUtils(&tft);
TimeUtils timeUtils = TimeUtils();
DiveUtils diveUtils = DiveUtils();

DateTimeCounter dateTimeCounter = DateTimeCounter(&tft);
PressureDisplay pressureDisplay = PressureDisplay(&tft);
TemperatureDisplay temperatureDisplay = TemperatureDisplay(&tft);
DepthDisplay depthDisplay = DepthDisplay(&tft, &diveUtils);

SettingsScreen settingsScreen = SettingsScreen(&tft, &screenUtils);
CalendarScreen calendarScreen = CalendarScreen(&tft, &screenUtils);
AboutScreen aboutScreen = AboutScreen(&tft, &screenUtils, &timeUtils, &dateTimeCounter);
HomeScreen homeScreen = HomeScreen(&tft, &screenUtils);
GaugeScreen gaugeScreen = GaugeScreen(&tft, &screenUtils, &timeUtils,
		&dateTimeCounter, &pressureDisplay, &temperatureDisplay, &depthDisplay);
DiveScreen diveScreen = DiveScreen(&tft, &screenUtils, &diveUtils,
		&temperatureDisplay, &depthDisplay);

int currentScreen = SCREEN_HOME;

void setup() {
	Serial.begin(115200);

	tft.begin();

	if (touchScreen.begin(40)) {
		Serial.println(F("Touch screen: OK\n"));
	} else {
		Serial.println(F("Touch screen: FAILED\n"));
		//Stop the sketch execution
		SD.initErrorHalt();
	}

	// SD Card initialization
	pinMode(SD_CS_PIN, OUTPUT);
	if (SD.begin(SD_CS_PIN, SPI_FULL_SPEED)) {
		Serial.println(F("SD card: OK\n"));
	} else {
		Serial.println(F("SD card: FAILED\n"));
		//Stop the sketch execution
		SysCall::halt();
	}

	// Real Time Clock (RTC) initialization
	if (rtc.begin()) {
		timerTimestamp = rtc.now().unixtime();

		Serial.print(F("RTC: OK - "));
		Serial.print(timeUtils.getCurrentTimeText());
		Serial.println("\n");
	} else {
		Serial.println(F("RTC: FAILED\n"));
		//Stop the sketch execution
		SysCall::halt();
	}

	// Pressure Sensor initialization
    if (pressureSensor.initializeMS_5803(false)) {
      Serial.println(F("\nPressure sensor: OK\n"));
    }
    else {
      Serial.println(F("\nPressure sensor: FAILED\n"));
    }

	homeScreen.open();
}

void loop() {
	updateTimer();

	int result = NO_ACTION;
	switch (currentScreen) {
		case SCREEN_HOME:
			result = homeScreen.handleTouch(&touchScreen);
			break;
		case SCREEN_SETTINGS:
			result = settingsScreen.handleTouch(&touchScreen);
			break;
		case SCREEN_CALENDAR:
			result = calendarScreen.handleTouch(&touchScreen);
			break;
		case SCREEN_ABOUT:
			result = aboutScreen.handleTouch(&touchScreen);
			break;
		case SCREEN_GAUGE:
			result = gaugeScreen.handleTouch(&touchScreen);
			break;
		case SCREEN_DIVE:
			result = diveScreen.handleTouch(&touchScreen);
			break;
	}

	switch (result) {
		case GO_SETTINGS:
			settingsScreen.open();
			currentScreen = SCREEN_SETTINGS;
			break;
		case GO_ABOUT:
			aboutScreen.open(VERSION_NUMBER);
			currentScreen = SCREEN_ABOUT;
			break;
		case GO_HOME:
			homeScreen.open();
			currentScreen = SCREEN_HOME;
			break;
		case GO_CALENDAR:
			calendarScreen.open();
			currentScreen = SCREEN_CALENDAR;
			break;
		case GO_GAUGE:
			pressureSensor.readSensor();
			gaugeScreen.open(pressureSensor.pressure(), pressureSensor.temperature());
			currentScreen = SCREEN_GAUGE;
			break;
		case GO_DIVE:
			pressureSensor.readSensor();
			diveScreen.open(pressureSensor.pressure(), pressureSensor.temperature());
			currentScreen = SCREEN_DIVE;
			break;
	}
}

void updateTimer()
{
	if (currentScreen == SCREEN_ABOUT || currentScreen == SCREEN_GAUGE || currentScreen == SCREEN_DIVE) {
		unsigned int measurementDifference = rtc.now().unixtime() - timerTimestamp;
		// Update the current time on the screen in every second
		if (measurementDifference > 0) {
			if (currentScreen == SCREEN_ABOUT) {
				aboutScreen.drawCurrentTime();
			} else if (currentScreen == SCREEN_GAUGE) {
				gaugeScreen.drawCurrentTime();

				//Update pressure and temperature information on the screen
				pressureSensor.readSensor();
				gaugeScreen.drawCurrentPressure(pressureSensor.pressure());
				gaugeScreen.drawCurrentTemperature(pressureSensor.temperature());

				//gaugeScreen.drawCurrentDepth(pressureSensor.pressure());
				gaugeScreen.drawCurrentDepth((float)random(950, 5000));
			} else if (currentScreen == SCREEN_DIVE) {
				//Update temperature information on the screen
				pressureSensor.readSensor();
				diveScreen.drawCurrentTemperature(pressureSensor.temperature());

				//diveScreen.drawCurrentDepth(pressureSensor.pressure());
				diveScreen.drawCurrentDepth((float)random(950, 5000));
			}
			timerTimestamp = rtc.now().unixtime();
		}
	}
}
